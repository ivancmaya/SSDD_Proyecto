## main/Kconfig.projbuild
```kconfig
menu "Application Configuration"

    config ESP_WIFI_AP_SSID
		string "WiFi SSID of AP mode"
		default "ap_ssid"
		help
			SSID (network name) for the AP created.

	config ESP_WIFI_AP_PASSWORD
		string "WiFi Password of AP mode"
		default "ap_password"
		help
			WiFi password (WPA or WPA2) for the AP created.

	config ESP_WIFI_AP_CHANNEL
		int "WiFi Channel of AP mode"
		range 1 13
		default 1
		help
			WiFi channel (network channel) for the AP created.

	config AP_MAX_STA_CONN
		int "Maximal STA connections of AP mode"
		default 4
		help
			Max number of the STA connects to AP.

    config ESP_WIFI_STA_SSID
        string "WiFi AP SSID"
        default "iPhone (2)"
        help
            SSID (network name) for the example to connect to.

    config ESP_WIFI_STA_PASSWORD
        string "WiFi Password"
        default "tive3hihok4yj"
        help
            WiFi password (WPA or WPA2) for the example to use.

    config ESP_STA_MAXIMUM_RETRY
        int "STA Maximum retry"
        default 5
        help
            Set the Maximum retry to avoid station reconnecting to the AP unlimited when the AP is really inexistent.

	config LED_1
		int "LED 1"
		default 27
		help
			GPIO number for red LED

	config LED_2
		int "LED 2"
		default 26
		help
			GPIO number for yellow LED

	config LEDC_OUTPUT_IO
		int "PWM OUT"
		default 14
		help
			GPIO number for PWM signal

	config DHT_11_GPIO
		int "DHT 11 Signal"
		default 12
		help
			GPIO number for DHT11 signal
endmenu
```
